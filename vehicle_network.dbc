VERSION "KAPEXLab Problem Statement 3 - Teaching Vehicle Network"

NS_ :

BS_:

BU_: VehicleECU Dashboard

BO_ 256 Vehicle_Speed: 8 VehicleECU
 SG_ VehicleSpeed : 0|16@1+ (0.1,0) [0|120] "km/h" Dashboard

BO_ 257 Engine_RPM: 8 VehicleECU
 SG_ EngineRPM : 0|16@1+ (1,0) [800|5000] "rpm" Dashboard

BO_ 258 Coolant_Temp: 8 VehicleECU
 SG_ CoolantTemperature : 0|16@1+ (0.1,-40) [20|120] "degC" Dashboard

BO_ 259 Fuel_Level: 8 VehicleECU
 SG_ FuelLevel : 0|16@1+ (0.5,0) [0|100] "%" Dashboard

BO_ 260 Battery_Status: 8 VehicleECU
 SG_ BatteryVoltage : 0|16@1+ (0.01,0) [11|15] "V" Dashboard

BO_ 261 Ambient_Temp: 8 VehicleECU
 SG_ AmbientTemperature : 0|16@1+ (0.1,-40) [-20|60] "degC" Dashboard

CM_ "Teaching DBC for a simulated vehicle information network. IDs and scaling are assignment design choices.";
CM_ BO_ 256 "Vehicle speed; physical range 0 to 120 km/h.";
CM_ BO_ 257 "Engine speed; physical range 800 to 5000 rpm.";
CM_ BO_ 258 "Coolant temperature; raw 600 to 1600 maps to 20 to 120 degC.";
CM_ BO_ 259 "Fuel level; 0.5 percent per bit.";
CM_ BO_ 260 "Battery voltage; 0.01 V per bit.";
CM_ BO_ 261 "Challenge 3 extension: ambient temperature; 0.1 degC per bit with -40 degC offset.";
